/*
 * CubeSat LQR + PWPF Controller - Self-Simulating with Wi-Fi Pose Updates
 */

// --- 1. SYSTEM CONSTANTS ---
const int NUM_STATES = 12;
const int NUM_THRUSTERS = 12; 
const int thrusterPins[12] = {43, 47, 49, 53, 45, 51, 48, 52, 42, 46, 50, 44};
const float MAX_THRUST = 0.025; 
const float DT = 0.01; // 100 Hz control loop 

// --- 2. PWPF MODULATOR PARAMETERS ---
const float Km = 4.0;
const float Tm = 0.1; 
const float Uon = 0.7; 
const float Uoff = 0.4;
const float Um = 1.0; // FIXED: Maximum modulator output is now 1.0 (100% duty cycle)

// --- 3. MATRICES ---

// === A. System Dynamics Matrix (Stays constant across configurations) ===
const float A_d[NUM_STATES][NUM_STATES] = {
  {1.0, 0.0, 0.0, 0.01, 0.0, 0.0, 0.0, 0.0, 0.0, 0.0, 0.0, 0.0},
  {0.0, 1.0, 0.0, 0.0, 0.01, 0.0, 0.0, 0.0, 0.0, 0.0, 0.0, 0.0},
  {0.0, 0.0, 1.0, 0.0, 0.0, 0.01, 0.0, 0.0, 0.0, 0.0, 0.0, 0.0},
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  {0.0, 0.0, 0.0, 0.0, 0.0, 0.0, 0.0, 0.0, 0.0, 0.0, 0.0, 1.0},
};

// === B. Input Dynamics Matrices (Changes with moment of inertia, which changes based on orientation) ===
const float B_d_T1[12][12] = {
  {      0.000000,       0.000000,       0.000000,       0.000000,       0.000000,       0.000000,       0.000000,       0.000000,       0.000000,       0.000000,       0.000000,       0.000000},
  {      0.000000,       0.000000,       0.000000,       0.000000,       0.000000,       0.000000,       0.000000,       0.000000,       0.000000,       0.000000,       0.000000,       0.000000},
  {      0.000000,       0.000000,       0.000000,       0.000000,       0.000000,       0.000000,       0.000000,       0.000000,       0.000000,       0.000000,       0.000000,       0.000000},
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  {      0.000000,      -0.000927,       0.000000,       0.000927,       0.000000,       0.000000,      -0.000000,      -0.000897,       0.000000,       0.000897,      -0.000000,      -0.000000},
};

const float B_d_T2[12][12] = {
  {      0.000000,       0.000000,       0.000000,       0.000000,       0.000000,       0.000000,       0.000000,       0.000000,       0.000000,       0.000000,       0.000000,       0.000000},
  {      0.000000,       0.000000,       0.000000,       0.000000,       0.000000,       0.000000,       0.000000,       0.000000,       0.000000,       0.000000,       0.000000,       0.000000},
  {      0.000000,       0.000000,       0.000000,       0.000000,       0.000000,       0.000000,       0.000000,       0.000000,       0.000000,       0.000000,       0.000000,       0.000000},
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  {      0.000000,      -0.000258,       0.000000,       0.000258,       0.000000,       0.000000,      -0.000000,      -0.000249,       0.000000,       0.000249,      -0.000000,      -0.000000},
};

const float B_d_T3[12][12] = {
  {      0.000000,       0.000000,       0.000000,       0.000000,       0.000000,       0.000000,       0.000000,       0.000000,       0.000000,       0.000000,       0.000000,       0.000000},
  {      0.000000,       0.000000,       0.000000,       0.000000,       0.000000,       0.000000,       0.000000,       0.000000,       0.000000,       0.000000,       0.000000,       0.000000},
  {      0.000000,       0.000000,       0.000000,       0.000000,       0.000000,       0.000000,       0.000000,       0.000000,       0.000000,       0.000000,       0.000000,       0.000000},
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  {      0.000000,      -0.000258,       0.000000,       0.000258,       0.000000,       0.000000,      -0.000000,      -0.000249,       0.000000,       0.000249,      -0.000000,      -0.000000},
};

// === C. LQR Gain Matrices (Changes based on orientation) ===
const float K_T1[12][12] = {
  {     -0.000000,      -0.000000,      -6.025383,       0.000000,      -0.000000,     -60.320103,       0.438415,       0.472822,       0.000000,       6.943382,       7.487223,      -0.000000},
  {      0.000000,      -6.025383,      -0.000000,       0.000000,     -60.320103,       0.000000,       0.362788,      -0.000000,      -0.335110,       5.745648,      -0.000000,      -5.302813},
  {      0.000000,       0.000000,       6.025383,      -0.000000,      -0.000000,      60.320103,       0.438415,      -0.472822,      -0.000000,       6.943382,      -7.487223,       0.000000},
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  {      6.025383,       0.000000,      -0.000000,      60.320103,       0.000000,      -0.000000,      -0.000000,      -0.284553,      -0.000000,       0.000000,      -4.505947,      -0.000000},
};

const float K_T2[12][12] = {
  {      0.000000,      -0.000000,      -6.025383,       0.000000,      -0.000000,     -60.320103,       0.346685,       0.204485,       0.000000,       6.942742,       4.092184,       0.000000},
  {     -0.000000,      -6.025383,      -0.000000,       0.000000,     -60.320103,       0.000000,       0.286881,      -0.000000,      -0.453328,       5.745119,      -0.000000,      -9.078691},
  {      0.000000,       0.000000,       6.025383,      -0.000000,      -0.000000,      60.320103,       0.346685,      -0.204485,      -0.000000,       6.942742,      -4.092184,      -0.000000},
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  {      6.025383,       0.000000,      -0.000000,      60.320103,       0.000000,       0.000000,       0.000000,      -0.123063,      -0.000000,      -0.000000,      -2.462751,      -0.000000},
};

const float K_T3[12][12] = {
  {     -0.000000,       0.000000,      -3.071234,       0.000000,      -0.000000,     -66.207526,       0.431426,       1.310120,      -0.000000,       5.397144,      16.389604,       0.000000},
  {      0.000000,      -3.071234,       0.000000,      -0.000000,     -66.207526,       0.000000,       0.357005,       0.000000,      -1.939146,       4.466137,      -0.000000,     -24.258730},
  {      0.000000,      -0.000000,       3.071234,      -0.000000,       0.000000,      66.207526,       0.431426,      -1.310120,       0.000000,       5.397144,     -16.389604,       0.000000},
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  {      3.071234,       0.000000,       0.000000,      66.207526,       0.000000,       0.000000,       0.000000,      -0.788454,      -0.000000,       0.000000,      -9.863562,      -0.000000},
};

// === D. Active Pointers (Defaults to T1) ===
const float (*active_B)[NUM_THRUSTERS] = B_d_T1; 
const float (*active_K)[NUM_STATES] = K_T1;

// --- 4. STATE VARIABLES ---
// FIXED: Zeroed out to match reference target and fix floating-point underflow bug
float x[NUM_STATES] = {0,0,0, 0,0,0, 0,0,0, 0,0,0};      // Current Pose
float x_ref[NUM_STATES] = {0,0,0, 0,0,0, 0,0,0, 0,0,0};  // Target Reference Pose

float f_states[NUM_THRUSTERS] = {0};
float u_pwpf[NUM_THRUSTERS] = {0};

// Timing variables
unsigned long previousMicros = 0;
const unsigned long intervalMicros = 10000;

// Serial Parsing Variables
const byte numChars = 64;
char receivedChars[numChars];
boolean newData = false;

void setup() {
  Serial.begin(115200);  // Serial Monitor for Plotting 
  Serial1.begin(115200); // Communication with NodeMCU 

  for (int i = 0; i < NUM_THRUSTERS; i++) {
    pinMode(thrusterPins[i], OUTPUT);
  }
  Serial.println("Starting Simulation..."); 
  delay(2000); // Give us time to open the Serial 
}

void loop() {
  // 1. Listen for new poses from the ESP8266 (Non-blocking)
  recvWithStartEndMarkers();
  updateReferencePose();

  // 2. Control & Sim Loop
  unsigned long currentMicros = micros();
  if (currentMicros - previousMicros >= intervalMicros) { 
    previousMicros = currentMicros;

    // ---------------------------------------------------------
    // A: Calculate Desired Continuous Control (u = -K * error)
    // ---------------------------------------------------------
    float u_desired[NUM_THRUSTERS] = {0};
    for (int i = 0; i < NUM_THRUSTERS; i++) { 
      for (int j = 0; j < NUM_STATES; j++) { 
        float error = x[j] - x_ref[j];
        u_desired[i] -= active_K[i][j] * error; // USING ACTIVE K POINTER
      }
    }

    // ---------------------------------------------------------
    // B: Apply PWPF Modulation
    // ---------------------------------------------------------
    float u_next_step[NUM_THRUSTERS] = {0};
    for (int i = 0; i < NUM_THRUSTERS; i++) { 
      
      // FIXED: 1. Normalize the LQR command to a -1.0 to 1.0 percentage scale
      float normalized_cmd = u_desired[i] / MAX_THRUST;
      
      // Clamp the normalized command 
      if (normalized_cmd > 1.0) normalized_cmd = 1.0;
      if (normalized_cmd < -1.0) normalized_cmd = -1.0;

      // FIXED: 2. PWPF Math (Operating purely on percentages)
      float e = normalized_cmd - u_pwpf[i];
      f_states[i] += (DT / Tm) * (Km * e - f_states[i]);
      
      float abs_f = abs(f_states[i]);
      if (abs_f >= Uon) {
        u_next_step[i] = (f_states[i] > 0) ? Um : -Um; // Outputs 1.0 or -1.0
      } else if (abs_f <= Uoff) { 
        u_next_step[i] = 0.0;
      } else {
        u_next_step[i] = u_pwpf[i];
      }
    }
    
    for (int i = 0; i < NUM_THRUSTERS; i++) { 
      u_pwpf[i] = u_next_step[i];
    }

    for (int i = 0; i < NUM_THRUSTERS; i++) { 
      if ((u_pwpf[i]) <= 0.0) {
        u_pwpf[i] = 0.0;
      }
    }

    // ---------------------------------------------------------
    // C: Actuate Physical Thrusters (LEDs)
    // ---------------------------------------------------------
    for (int i = 0; i < NUM_THRUSTERS; i++) { 
      Serial.print(u_pwpf[i]); // Now prints 0.0 or 1.0 
      Serial.print("\t"); 
      
      // FIXED: Updated threshold to check against the normalized output
      if ((u_pwpf[i]) > 0.5) { 
        digitalWrite(thrusterPins[i], HIGH);
      } else {
        digitalWrite(thrusterPins[i], LOW);
      }
    }

    Serial.println();
    
    // ---------------------------------------------------------
    // D: Simulate System Dynamics (X_next = A_d*X + B_d*u)
    // ---------------------------------------------------------
    float x_next[NUM_STATES] = {0};
    for (int i = 0; i < NUM_STATES; i++) { 
      float ax = 0;
      float bu = 0;
      
      for (int j = 0; j < NUM_STATES; j++) { 
        ax += A_d[i][j] * x[j];
      }
      
      for (int j = 0; j < NUM_THRUSTERS; j++) { 
        // FIXED: Multiply normalized state (0.0 to 1.0) by MAX_THRUST to get Newtons for physical sim!
        bu += active_B[i][j] * (u_pwpf[j] * MAX_THRUST);
      }
      
      x_next[i] = ax + bu;
    }

    for (int i = 0; i < NUM_STATES; i++) { 
      x[i] = x_next[i];
    }

    // Print Positional States for Serial Plotter
    Serial.print(x[0]); Serial.print(",");
    Serial.print(x[1]); Serial.print(","); 
    Serial.println(x[2]);
  }
}

// ---------------------------------------------------------
// Helper Functions for Serial Parsing
// ---------------------------------------------------------
void recvWithStartEndMarkers() {
  static boolean recvInProgress = false;
  static byte ndx = 0;
  char startMarker = '<';
  char endMarker = '>';
  char rc;
  while (Serial1.available() > 0 && newData == false) {
    rc = Serial1.read();
    if (recvInProgress == true) {
      if (rc != endMarker) {
        receivedChars[ndx] = rc;
        ndx++;
        if (ndx >= numChars) {
          ndx = numChars - 1;
        }
      } else {
        receivedChars[ndx] = '\0'; // terminate the string
        recvInProgress = false;
        ndx = 0;
        newData = true;
      }
    } else if (rc == startMarker) {
      recvInProgress = true;
    }
  }
}

void updateReferencePose() {
  if (newData == true) {
    char * strtokIndx;
    // 0. Parse Configuration String and SET BOTH POINTERS
    strtokIndx = strtok(receivedChars, ",");
    if (strtokIndx != NULL) {
      if (strcmp(strtokIndx, "T1") == 0) {
        active_K = K_T1;
        active_B = B_d_T1;
      }
      else if (strcmp(strtokIndx, "T2") == 0) {
        active_K = K_T2;
        active_B = B_d_T2;
      }
      else if (strcmp(strtokIndx, "T3") == 0) {
        active_K = K_T3;
        active_B = B_d_T3;
      }
    }

    // 1. Parse Positions (Assuming indices 0, 1, 2)
    strtokIndx = strtok(NULL, ",");
    if (strtokIndx != NULL) x_ref[0] = atof(strtokIndx);
    
    strtokIndx = strtok(NULL, ",");
    if (strtokIndx != NULL) x_ref[1] = atof(strtokIndx);
    
    strtokIndx = strtok(NULL, ",");
    if (strtokIndx != NULL) x_ref[2] = atof(strtokIndx);
    
    // 2. Parse Angles (Assuming indices 6, 7, 8)
    strtokIndx = strtok(NULL, ",");
    if (strtokIndx != NULL) x_ref[6] = atof(strtokIndx); // Roll
    
    strtokIndx = strtok(NULL, ",");
    if (strtokIndx != NULL) x_ref[7] = atof(strtokIndx); // Pitch

    strtokIndx = strtok(NULL, ",");
    if (strtokIndx != NULL) x_ref[8] = atof(strtokIndx); // Yaw

    newData = false; // reset flag
  }
}